## config/west.yml
```yaml
manifest:
  remotes:
    - name: zmkfirmware
      url-base: https://github.com/zmkfirmware
    - name: elpekenin
      url-base: https://github.com/elpekenin
  projects:
    - name: zmk-userspace
      remote: elpekenin
      revision: main
    - name: zmk
      remote: zmkfirmware
      revision: main
      import: app/west.yml
  self:
    path: config
```
